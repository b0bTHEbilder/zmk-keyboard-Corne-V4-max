## boards/shields/cornev4max/Kconfig.defconfig
```kconfig
if SHIELD_CORNEV4MAX

# Name must be less than 16 characters long!
config ZMK_KEYBOARD_NAME
    default "Corne V4 Max"

config ZMK_SPLIT_ROLE_CENTRAL
    default y

endif

if SHIELD_CORNEV4MAX_LEFT || SHIELD_CORNEV4MAX_RIGHT

config ZMK_SPLIT
    default y

endif
```

## boards/shields/cornev4max/Kconfig.shield
```kconfig
# No whitespace after the comma or in your part name!
config SHIELD_CORNEV4MAX_LEFT
    def_bool $(shields_list_contains,cornev4max_left)

# No whitespace after the comma or in your part name!
config SHIELD_CORNEV4MAX_RIGHT
    def_bool $(shields_list_contains,cornev4max_right)
```
